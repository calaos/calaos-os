## conf/bblayers.conf
```bitbake
# LAYER_CONF_VERSION is increased each time build/conf/bblayers.conf
# changes incompatibly
LCONF_VERSION = "6"
TOPDIR := "${@os.path.dirname(os.path.dirname(d.getVar('FILE', True)))}"

BBPATH = "${TOPDIR}"

BBFILES = ""

BBLAYERS ?= " \
  ${TOPDIR}/src/oe-core/meta \
  ${TOPDIR}/src/meta-openembedded/meta-oe \
  ${TOPDIR}/src/meta-openembedded/meta-gnome \
  ${TOPDIR}/src/meta-openembedded/meta-python \
  ${TOPDIR}/src/meta-openembedded/meta-multimedia \
  ${TOPDIR}/src/meta-openembedded/meta-networking \
  ${TOPDIR}/src/meta-openembedded/meta-webserver \
  ${TOPDIR}/src/meta-openembedded/meta-filesystems \
  ${TOPDIR}/src/meta-intel \
  ${TOPDIR}/src/meta-yocto/meta-yocto-bsp \
  ${TOPDIR}/src/meta-qt5 \
  ${TOPDIR}/src/meta-sunxi \
  ${TOPDIR}/src/meta-raspberrypi \
  ${TOPDIR}/src/meta-calaos \
  "
```

## conf/local.conf
```bitbake
# CONF_VERSION is increased each time build/conf/ changes incompatibly
CONF_VERSION = "1"

#INHERIT += "rm_work"

# Which files do we want to parse:
BBMASK = ""

# What kind of images do we want?
IMAGE_FSTYPES_append = " tar.xz"

# Make use of SMP:
#   PARALLEL_MAKE specifies how many concurrent compiler threads are spawned per bitbake process
#   BB_NUMBER_THREADS specifies how many concurrent bitbake tasks will be run
PARALLEL_MAKE     = "-j24"
BB_NUMBER_THREADS = "6"

DISTRO = "calaos"

# Don't generate the mirror tarball for SCM repos, the snapshot is enough
BB_GENERATE_MIRROR_TARBALLS = "0"

#PREFERRED_VERSION_linux-intel ?= "4.19.%"

# Disable build time patch resolution. This would lauch a devshell
# and wait for manual intervention. We disable it.
PATCHRESOLVE = "noop"

PACKAGE_CLASSES ?= "package_ipk"
EXTRA_IMAGE_FEATURES = "debug-tweaks tools-profile"
USER_CLASSES ?= "buildstats image-mklibs"

BB_DISKMON_DIRS = "\
    STOPTASKS,${TMPDIR},1G,100K \
    STOPTASKS,${DL_DIR},1G,100K \
    STOPTASKS,${SSTATE_DIR},1G,100K \
    ABORT,${TMPDIR},100M,1K \
    ABORT,${DL_DIR},100M,1K \
    ABORT,${SSTATE_DIR},100M,1K"

LICENSE_FLAGS_WHITELIST = "commercial"

#enable PR service
PRSERV_HOST = "localhost:0"

#Enable this to configure opkg to use this host as a package provider
PACKAGE_FEED_URIS = "http://192.168.0.12:8000"
```
